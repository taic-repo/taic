# TAIC register map
File version: 0.0
Task-Aware interrupt controller description.
Registers are 64-bit, write-only, reset 0x0 unless marked. A register's access mark holds for its fields unless they carry their own. Offsets are from the block's base; lines under a group give offsets from that group; [hi:lo] are bit positions; {n}, {i} and the like mark numbered series; 'fields as' and 'values as' point back to an identical list; <NAME> marks a mode.

## Memory map
0x01000000 TAIC size 0x1000000 — Task-Aware interrupt controller description.

## TAIC — Task-Aware interrupt controller description.
Base 0x01000000
0x00 alq rw — Alloc a local ready queue.
0x08 flq — Free a local ready queue.
{0x1000+0x1000*i} lq_{i} (i=0..255) group — Related registers space of per local queue
  0x00 task_enqueue — Add task into the local ready queue.
  0x08 task_dequeue ro — Fetch a task from the local ready queue.
    [64:6] tcb — The pointer of task control block.
    [5:1] priority — The priority attribute about task.
    [0] is_preempt — The preempt attribute about task.
  0x18 register_sender — Register send capability.
  0x20 cancel_sender — Cancel send capability.
  0x28 register_receiver — Register receive capability.
  0x30 send_intr — Send interrupt to receiver.
  0x38 whart — Write the hartid about the local queue.
